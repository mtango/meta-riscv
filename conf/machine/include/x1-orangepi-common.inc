## conf/machine/include/x1-orangepi-common.inc
```bitbake
#@TYPE: Include
#@NAME: x1-orangepi-common
#@DESCRIPTION: Common configuration for Ky X1 OrangePi boards

require conf/machine/include/riscv/tune-riscv.inc

PREFERRED_PROVIDER_virtual/kernel ?= "linux-orangepi"
PREFERRED_PROVIDER_virtual/bootloader ?= "u-boot-orangepi"

UBOOT_MACHINE = "x1_defconfig"
SPL_BINARY = "spl/u-boot-spl.bin"
UBOOT_ENV = "boot"
UBOOT_ENV_SUFFIX = "scr"

RISCV_SBI_PLAT = "generic"

KERNEL_CLASSES = "kernel"
KERNEL_IMAGETYPE = "Image"

EXTRA_IMAGEDEPENDS += "u-boot-orangepi"

INITRAMFS_FSTYPES = "cpio.gz"
IMAGE_FSTYPES += "wic.gz wic.bmap ext4"

WIC_CREATE_EXTRA_ARGS ?= "--no-fstab-update"

SERIAL_CONSOLES = "115200;ttyS0"
MACHINE_EXTRA_RRECOMMENDS += "kernel-modules linux-firmware-orangepi"
```

## conf/machine/orangepi-r2s.conf
```bitbake
#@TYPE: Machine
#@NAME: orangepi-r2s
#@SOC: Ky X1
#@DESCRIPTION: Machine configuration for OrangePi R2S

require conf/machine/include/x1-orangepi-common.inc

# Shared SoC-level override for Ky X1 OrangePi boards
MACHINEOVERRIDES .= ":x1-orangepi"

KERNEL_DEVICETREE ?= "ky/x1_orangepi-r2s.dtb"

IMAGE_BOOT_FILES += " \
	${UBOOT_ENV}.${UBOOT_ENV_SUFFIX} \
	x1_orangepi-r2s.dtb \
	${KERNEL_IMAGETYPE} \
	initramfs.img"

WKS_FILE ?= "orangepi-r2s.wks"

MACHINE_FEATURES = "keyboard ext2 ext3 serial"
```

## conf/machine/orangepi-rv2.conf
```bitbake
#@TYPE: Machine
#@NAME: orangepi-rv2
#@SOC: Ky X1
#@DESCRIPTION: Machine configuration for OrangePi RV2

require conf/machine/include/x1-orangepi-common.inc

# Shared SoC-level override for Ky X1 OrangePi boards
MACHINEOVERRIDES .= ":x1-orangepi"

KERNEL_DEVICETREE ?= "ky/x1_orangepi-rv2.dtb"

IMAGE_BOOT_FILES += " \
	${UBOOT_ENV}.${UBOOT_ENV_SUFFIX} \
	x1_orangepi-rv2.dtb \
	${KERNEL_IMAGETYPE} \
	initramfs.img"

WKS_FILE ?= "orangepi-rv2.wks"

MACHINE_FEATURES = "screen keyboard ext2 ext3 serial"
```
